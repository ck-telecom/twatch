## app/boards/xtenssa/twatch/Kconfig.defconfig
```kconfig
# TTGO TWACTH series configuration

# Copyright (c) 2022 Qingsong Gou <gouqs@hotmail.com>
# SPDX-License-Identifier: Apache-2.0

if BOARD_TWATCH_V3

config BOARD
	default "twach_v3" if BOARD_TWATCH_V3

config ENTROPY_ESP32_RNG
	default y if ENTROPY_GENERATOR

if BT

config HEAP_MEM_POOL_SIZE
	default 16384

config ENTROPY_GENERATOR
	default y

choice BT_HCI_BUS_TYPE
	default BT_ESP32
endchoice

endif # BT

endif # BOARD_TWATCH_V3
```

## app/drivers/sensor/Kconfig
```kconfig
# Sensor configuration options

# Copyright (c) 2016 Intel Corporation
# SPDX-License-Identifier: Apache-2.0


if SENSOR

rsource "bma423/Kconfig"

rsource "pcf8653/Kconfig"

endif # SENSOR
```

## app/drivers/sensor/axp202/zephyr/Kconfig
```kconfig
# AXP202 PMIC

# Copyright (c) 2022 Qingsong Gou <gouqs@hotmail.com>
# SPDX-License-Identifier: Apache-2.0

config AXP202
	bool "AXP202 PMIC"
	select SENSOR
	depends on I2C

if AXP202

choice
	prompt "Trigger mode"
	default AXP202_TRIGGER_GLOBAL_THREAD
	help
	  Specify the type of triggering to be used by the driver.

config AXP202_TRIGGER_NONE
	bool "No trigger"

config AXP202_TRIGGER_GLOBAL_THREAD
	bool "Use global thread"
	depends on GPIO
	select AXP202_TRIGGER

config AXP202_TRIGGER_OWN_THREAD
	bool "Use own thread"
	depends on GPIO
	select AXP202_TRIGGER

endchoice

config AXP202_TRIGGER
	bool "Use AXP202 trigger"

config AXP202_THREAD_PRIORITY
	int "Thread priority"
	depends on AXP202_TRIGGER_OWN_THREAD
	default 10
	help
	  Priority of thread used by the driver to handle interrupts.

config AXP202_THREAD_STACK_SIZE
	int "Thread stack size"
	depends on AXP202_TRIGGER_OWN_THREAD
	default 1024
	help
	  Stack size of thread used by the driver to handle interrupts.

endif # AXP202
```

## app/drivers/sensor/bma423/zephyr/Kconfig
```kconfig
# BMA423 Three Axis Accelerometer configuration options

# Copyright (c) 2022 Qingsong Gou <gouqs@hotmail.com>
# SPDX-License-Identifier: Apache-2.0

config BMA423
	bool "BMA423 Three Axis Accelerometer Family"
	depends on I2C
	help
	  Enable driver for BMA423 I2C-based triaxial accelerometer sensor
	  family.

if BMA423

choice
	prompt "Trigger mode"
	default BMA423_TRIGGER_GLOBAL_THREAD
	help
	  Specify the type of triggering to be used by the driver.

config BMA423_TRIGGER_NONE
	bool "No trigger"

config BMA423_TRIGGER_GLOBAL_THREAD
	bool "Use global thread"
	depends on GPIO
	select BMA423_TRIGGER

config BMA423_TRIGGER_OWN_THREAD
	bool "Use own thread"
	depends on GPIO
	select BMA423_TRIGGER

endchoice

config BMA423_TRIGGER
	bool "Use BMA423 trigger"

config BMA423_THREAD_PRIORITY
	int "Thread priority"
	depends on BMA423_TRIGGER_OWN_THREAD
	default 10
	help
	  Priority of thread used by the driver to handle interrupts.

config BMA423_THREAD_STACK_SIZE
	int "Thread stack size"
	depends on BMA423_TRIGGER_OWN_THREAD
	default 1024
	help
	  Stack size of thread used by the driver to handle interrupts.

config BMA423_ACC_PERF_MODE
	bool "Performance Mode or Averaging mode"

choice
	prompt "Acceleration measurement range"
	default BMA423_ACC_RANGE_2G
	help
	  Measurement range for acceleration values.

config BMA423_ACC_RANGE_2G
	bool "+/-2g"

config BMA423_ACC_RANGE_4G
	bool "+/-4g"

config BMA423_ACC_RANGE_8G
	bool "+/-8g"

config BMA423_ACC_RANGE_16G
	bool "+/-16g"

endchoice

choice
	prompt "Acceleration data filter bandwidth"
	default BMA423_ACC_ODR_50HZ
	help
	  Bandwidth of filtered acceleration data.
	  When perf mode disabled, ODR must be set to min 50Hz for most features
	  and min 200Hz for double feature

config BMA423_ACC_ODR_0_78HZ
	bool "0.781Hz"

config BMA423_ACC_ODR_1_56HZ
	bool "1.563HZ"

config BMA423_ACC_ODR_3_12HZ
	bool "3.125Hz"

config BMA423_ACC_ODR_6_25HZ
	bool "6.25Hz"

config BMA423_ACC_ODR_12_5HZ
	bool "12.5Hz"

config BMA423_ACC_ODR_25HZ
	bool "25.0Hz"

config BMA423_ACC_ODR_50HZ
	bool "50Hz"

config BMA423_ACC_ODR_100HZ
	bool "100Hz"

config BMA423_ACC_ODR_200HZ
	bool "200Hz"

config BMA423_ACC_ODR_400HZ
	bool "400Hz"

config BMA423_ACC_ODR_800HZ
	bool "800Hz"

config BMA423_ACC_ODR_1600HZ
	bool "1600Hz"

config BMA423_PMU_ODR_UNFILTR
	bool "unfiltered"

endchoice

choice
	prompt "Bandwidth parameter"
	default BMA423_ACC_BWP_NORM_AVG4
	help
	  "Determine filter config (Perf mode) and averaging for undersampling mode"

config BMA423_ACC_BWP_OSR4_AVG1
	bool "Perf. mode => OSR4 Mode / Avg mode => No averaging"

config BMA423_ACC_BWP_OSR2_AVG2
	bool "Perf. mode => OSR2 Mode / Avg mode => Average 2 samples"

config BMA423_ACC_BWP_NORM_AVG4
	bool "Perf. mode => Normal Mode / Avg mode => Average 4 samples"

config BMA423_ACC_BWP_CIC_AVG8
	bool "Perf. mode => Reserved / Avg mode => Average 8 samples"

config BMA423_ACC_BWP_RES_AVG16
	bool "Perf. mode => Reserved / Avg mode => Average 16 samples"

config BMA423_ACC_BWP_RES_AVG32
	bool "Perf. mode => Reserved / Avg mode => Average 32 samples"

config BMA423_ACC_BWP_RES_AVG64
	bool "Perf. mode => Reserved / Avg mode => Average 64 samples"

config BMA423_ACC_BWP_RES_AVG128
	bool "Perf. mode => Reserved / Avg mode => Average 128 samples"

endchoice

endif # BMA423
```

## app/drivers/sensor/pcf8653/zephyr/Kconfig
```kconfig
# PCF8653 NXP Real Time Clock IC

# Copyright (c) 2022 Qingsong Gou <gouqs@hotmail.com>
# SPDX-License-Identifier: Apache-2.0

config PCF8653
	bool "support pcf8653 rtc ic"
	depends on I2C
	help
	  Enable driver for pcf8653 real time clock ic.

if PCF8653

choice
	prompt "Trigger mode"
	default PCF8653_TRIGGER_GLOBAL_THREAD
	help
	  Specify the type of triggering to be used by the driver.

config PCF8653_TRIGGER_NONE
	bool "No trigger"

config PCF8653_TRIGGER_GLOBAL_THREAD
	bool "Use global thread"
	depends on GPIO
	select PCF8653_TRIGGER

config PCF8653_TRIGGER_OWN_THREAD
	bool "Use own thread"
	depends on GPIO
	select PCF8653_TRIGGER

endchoice

config PCF8653_TRIGGER
	bool "Use PCF8653 trigger"

config PCF8653_THREAD_PRIORITY
	int "Thread priority"
	depends on PCF8653_TRIGGER_OWN_THREAD
	default 10
	help
	  Priority of thread used by the driver to handle interrupts.

config PCF8653_THREAD_STACK_SIZE
	int "Thread stack size"
	depends on PCF8653_TRIGGER_OWN_THREAD
	default 1024
	help
	  Stack size of thread used by the driver to handle interrupts.

endif # PCF8653
```

## west.yml
```yaml
# SPDX-License-Identifier: Apache-2.0

manifest:
  defaults:
    remote: zephyrproject-rtos

  remotes:
    - name: zephyrproject-rtos
      url-base: https://github.com/zephyrproject-rtos

    - name: gitee
      url-base: https://gitee.com/fwatch

  # External projects
  #
  projects:
    - name: hal_espressif
      revision: bcd7565ffa390d5774dc2fbe71a002faa9a7d082
      path: modules/hal/espressif
      west-commands: west/west-commands.yml
      groups:
        - hal

    - name: tinycrypt
      revision: 3e9a49d2672ec01435ffbf0d788db6d95ef28de0
      path: modules/crypto/tinycrypt

    - name: zephyr
      west-commands: scripts/west-commands.yml
      revision: main

  self:
    path: twatch
```
